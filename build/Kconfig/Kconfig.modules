## build/Kconfig/Kconfig.modules
```kconfig
config ZEPHYR_HAL_STM32_MODULE
	bool
	default y

config ZEPHYR_HAL_STM32_MODULE_BLOBS
	bool
menu "lvgl (/home/runner/work/ILI9341-nrf52840/ILI9341-nrf52840/modules/lib/gui/lvgl)"
osource "/home/runner/work/ILI9341-nrf52840/ILI9341-nrf52840/modules/lib/gui/lvgl/zephyr/Kconfig"
config ZEPHYR_LVGL_MODULE
	bool
	default y
endmenu
config ZEPHYR_ZMK_STUDIO_MESSAGES_MODULE
	bool
	default y
menu "canopennode (/home/runner/work/ILI9341-nrf52840/ILI9341-nrf52840/modules/lib/canopennode)"
osource "$(ZEPHYR_CANOPENNODE_KCONFIG)"
config ZEPHYR_CANOPENNODE_MODULE
	bool
	default y
endmenu
menu "chre (/home/runner/work/ILI9341-nrf52840/ILI9341-nrf52840/modules/lib/chre)"
osource "/home/runner/work/ILI9341-nrf52840/ILI9341-nrf52840/modules/lib/chre/platform/zephyr/Kconfig"
config ZEPHYR_CHRE_MODULE
	bool
	default y
endmenu
menu "lz4 (/home/runner/work/ILI9341-nrf52840/ILI9341-nrf52840/modules/lib/lz4)"
osource "$(ZEPHYR_LZ4_KCONFIG)"
config ZEPHYR_LZ4_MODULE
	bool
	default y
endmenu
menu "nanopb (/home/runner/work/ILI9341-nrf52840/ILI9341-nrf52840/modules/lib/nanopb)"
osource "$(ZEPHYR_NANOPB_KCONFIG)"
config ZEPHYR_NANOPB_MODULE
	bool
	default y
endmenu
config ZEPHYR_PSA_ARCH_TESTS_MODULE
	bool
	default y
menu "sof (/home/runner/work/ILI9341-nrf52840/ILI9341-nrf52840/modules/audio/sof)"
osource "/home/runner/work/ILI9341-nrf52840/ILI9341-nrf52840/modules/audio/sof/zephyr/Kconfig"
config ZEPHYR_SOF_MODULE
	bool
	default y
endmenu
config ZEPHYR_TF_M_TESTS_MODULE
	bool
	default y
menu "tflite-micro (/home/runner/work/ILI9341-nrf52840/ILI9341-nrf52840/optional/modules/lib/tflite-micro)"
osource "$(ZEPHYR_TFLITE_MICRO_KCONFIG)"
config ZEPHYR_TFLITE_MICRO_MODULE
	bool
	default y
endmenu
menu "thrift (/home/runner/work/ILI9341-nrf52840/ILI9341-nrf52840/optional/modules/lib/thrift)"
osource "$(ZEPHYR_THRIFT_KCONFIG)"
config ZEPHYR_THRIFT_MODULE
	bool
	default y
endmenu
menu "lang-rust (/home/runner/work/ILI9341-nrf52840/ILI9341-nrf52840/modules/lang/rust)"
osource "/home/runner/work/ILI9341-nrf52840/ILI9341-nrf52840/modules/lang/rust/Kconfig"
config ZEPHYR_LANG_RUST_MODULE
	bool
	default y
endmenu
menu "zscilib (/home/runner/work/ILI9341-nrf52840/ILI9341-nrf52840/modules/lib/zscilib)"
osource "/home/runner/work/ILI9341-nrf52840/ILI9341-nrf52840/modules/lib/zscilib/Kconfig.zscilib"
config ZEPHYR_ZSCILIB_MODULE
	bool
	default y
endmenu
menu "acpica (/home/runner/work/ILI9341-nrf52840/ILI9341-nrf52840/modules/lib/acpica)"
osource "$(ZEPHYR_ACPICA_KCONFIG)"
config ZEPHYR_ACPICA_MODULE
	bool
	default y
endmenu
menu "cmsis (/home/runner/work/ILI9341-nrf52840/ILI9341-nrf52840/modules/hal/cmsis)"
osource "$(ZEPHYR_CMSIS_KCONFIG)"
config ZEPHYR_CMSIS_MODULE
	bool
	default y
endmenu
menu "cmsis-dsp (/home/runner/work/ILI9341-nrf52840/ILI9341-nrf52840/modules/lib/cmsis-dsp)"
osource "$(ZEPHYR_CMSIS_DSP_KCONFIG)"
config ZEPHYR_CMSIS_DSP_MODULE
	bool
	default y
endmenu
menu "cmsis-nn (/home/runner/work/ILI9341-nrf52840/ILI9341-nrf52840/modules/lib/cmsis-nn)"
osource "$(ZEPHYR_CMSIS_NN_KCONFIG)"
config ZEPHYR_CMSIS_NN_MODULE
	bool
	default y
endmenu
menu "fatfs (/home/runner/work/ILI9341-nrf52840/ILI9341-nrf52840/modules/fs/fatfs)"
osource "$(ZEPHYR_FATFS_KCONFIG)"
config ZEPHYR_FATFS_MODULE
	bool
	default y
endmenu
config ZEPHYR_ADI_MODULE
	bool
	default y
menu "hal_ambiq (/home/runner/work/ILI9341-nrf52840/ILI9341-nrf52840/modules/hal/ambiq)"
osource "$(ZEPHYR_HAL_AMBIQ_KCONFIG)"
config ZEPHYR_HAL_AMBIQ_MODULE
	bool
	default y
endmenu
config ZEPHYR_ATMEL_MODULE
	bool
	default y
menu "hal_espressif (/home/runner/work/ILI9341-nrf52840/ILI9341-nrf52840/modules/hal/espressif)"
osource "/home/runner/work/ILI9341-nrf52840/ILI9341-nrf52840/modules/hal/espressif/zephyr/Kconfig"
config ZEPHYR_HAL_ESPRESSIF_MODULE
	bool
	default y

config ZEPHYR_HAL_ESPRESSIF_MODULE_BLOBS
	bool
endmenu
menu "hal_ethos_u (/home/runner/work/ILI9341-nrf52840/ILI9341-nrf52840/modules/hal/ethos_u)"
osource "$(ZEPHYR_HAL_ETHOS_U_KCONFIG)"
config ZEPHYR_HAL_ETHOS_U_MODULE
	bool
	default y
endmenu
menu "hal_gigadevice (/home/runner/work/ILI9341-nrf52840/ILI9341-nrf52840/modules/hal/gigadevice)"
osource "$(ZEPHYR_HAL_GIGADEVICE_KCONFIG)"
config ZEPHYR_HAL_GIGADEVICE_MODULE
	bool
	default y
endmenu
menu "hal_intel (/home/runner/work/ILI9341-nrf52840/ILI9341-nrf52840/modules/hal/intel)"
osource "/home/runner/work/ILI9341-nrf52840/ILI9341-nrf52840/modules/hal/intel/zephyr/Kconfig"
config ZEPHYR_HAL_INTEL_MODULE
	bool
	default y
endmenu
menu "hal_nordic (/home/runner/work/ILI9341-nrf52840/ILI9341-nrf52840/modules/hal/nordic)"
osource "$(ZEPHYR_HAL_NORDIC_KCONFIG)"
config ZEPHYR_HAL_NORDIC_MODULE
	bool
	default y

config ZEPHYR_HAL_NORDIC_MODULE_BLOBS
	bool
endmenu
config ZEPHYR_NUVOTON_MODULE
	bool
	default y
config ZEPHYR_QUICKLOGIC_MODULE
	bool
	default y
config ZEPHYR_HAL_RENESAS_MODULE
	bool
	default y

config ZEPHYR_HAL_RENESAS_MODULE_BLOBS
	bool
menu "hal_rpi_pico (/home/runner/work/ILI9341-nrf52840/ILI9341-nrf52840/modules/hal/rpi_pico)"
osource "$(ZEPHYR_HAL_RPI_PICO_KCONFIG)"
config ZEPHYR_HAL_RPI_PICO_MODULE
	bool
	default y
endmenu
menu "hal_silabs (/home/runner/work/ILI9341-nrf52840/ILI9341-nrf52840/modules/hal/silabs)"
osource "$(ZEPHYR_HAL_SILABS_KCONFIG)"
config ZEPHYR_HAL_SILABS_MODULE
	bool
	default y

config ZEPHYR_HAL_SILABS_MODULE_BLOBS
	bool
endmenu
menu "hal_tdk (/home/runner/work/ILI9341-nrf52840/ILI9341-nrf52840/modules/hal/tdk)"
osource "$(ZEPHYR_HAL_TDK_KCONFIG)"
config ZEPHYR_HAL_TDK_MODULE
	bool
	default y
endmenu
menu "hal_telink (/home/runner/work/ILI9341-nrf52840/ILI9341-nrf52840/modules/hal/telink)"
osource "/home/runner/work/ILI9341-nrf52840/ILI9341-nrf52840/modules/hal/telink/Kconfig"
config ZEPHYR_HAL_TELINK_MODULE
	bool
	default y
endmenu
menu "hal_wch (/home/runner/work/ILI9341-nrf52840/ILI9341-nrf52840/modules/hal/wch)"
osource "$(ZEPHYR_HAL_WCH_KCONFIG)"
config ZEPHYR_HAL_WCH_MODULE
	bool
	default y
endmenu
config ZEPHYR_HAL_WURTHELEKTRONIK_MODULE
	bool
	default y
menu "hostap (/home/runner/work/ILI9341-nrf52840/ILI9341-nrf52840/modules/lib/hostap)"
osource "$(ZEPHYR_HOSTAP_KCONFIG)"
config ZEPHYR_HOSTAP_MODULE
	bool
	default y
endmenu
menu "liblc3 (/home/runner/work/ILI9341-nrf52840/ILI9341-nrf52840/modules/lib/liblc3)"
osource "$(ZEPHYR_LIBLC3_KCONFIG)"
config ZEPHYR_LIBLC3_MODULE
	bool
	default y
endmenu
config ZEPHYR_LIBMCTP_MODULE
	bool
	default y
config ZEPHYR_LIBMETAL_MODULE
	bool
	default y
menu "littlefs (/home/runner/work/ILI9341-nrf52840/ILI9341-nrf52840/modules/fs/littlefs)"
osource "$(ZEPHYR_LITTLEFS_KCONFIG)"
config ZEPHYR_LITTLEFS_MODULE
	bool
	default y
endmenu
menu "mbedtls (/home/runner/work/ILI9341-nrf52840/ILI9341-nrf52840/modules/crypto/mbedtls)"
osource "$(ZEPHYR_MBEDTLS_KCONFIG)"
config ZEPHYR_MBEDTLS_MODULE
	bool
	default y
endmenu
config ZEPHYR_MIPI_SYS_T_MODULE
	bool
	default y
menu "nrf_wifi (/home/runner/work/ILI9341-nrf52840/ILI9341-nrf52840/modules/lib/nrf_wifi)"
osource "$(ZEPHYR_NRF_WIFI_KCONFIG)"
config ZEPHYR_NRF_WIFI_MODULE
	bool
	default y

config ZEPHYR_NRF_WIFI_MODULE_BLOBS
	bool
endmenu
config ZEPHYR_OPEN_AMP_MODULE
	bool
	default y
menu "percepio (/home/runner/work/ILI9341-nrf52840/ILI9341-nrf52840/modules/debug/percepio)"
osource "/home/runner/work/ILI9341-nrf52840/ILI9341-nrf52840/modules/debug/percepio/zephyr/Kconfig"
config ZEPHYR_PERCEPIO_MODULE
	bool
	default y
endmenu
menu "picolibc (/home/runner/work/ILI9341-nrf52840/ILI9341-nrf52840/modules/lib/picolibc)"
osource "/home/runner/work/ILI9341-nrf52840/ILI9341-nrf52840/modules/lib/picolibc/zephyr/Kconfig"
config ZEPHYR_PICOLIBC_MODULE
	bool
	default y
endmenu
menu "segger (/home/runner/work/ILI9341-nrf52840/ILI9341-nrf52840/modules/debug/segger)"
osource "$(ZEPHYR_SEGGER_KCONFIG)"
config ZEPHYR_SEGGER_MODULE
	bool
	default y
endmenu
config ZEPHYR_TINYCRYPT_MODULE
	bool
	default y
menu "trusted-firmware-a (/home/runner/work/ILI9341-nrf52840/ILI9341-nrf52840/modules/tee/tf-a/trusted-firmware-a)"
osource "$(ZEPHYR_TRUSTED_FIRMWARE_A_KCONFIG)"
config ZEPHYR_TRUSTED_FIRMWARE_A_MODULE
	bool
	default y
endmenu
menu "uoscore-uedhoc (/home/runner/work/ILI9341-nrf52840/ILI9341-nrf52840/modules/lib/uoscore-uedhoc)"
osource "$(ZEPHYR_UOSCORE_UEDHOC_KCONFIG)"
config ZEPHYR_UOSCORE_UEDHOC_MODULE
	bool
	default y
endmenu
menu "zcbor (/home/runner/work/ILI9341-nrf52840/ILI9341-nrf52840/modules/lib/zcbor)"
osource "$(ZEPHYR_ZCBOR_KCONFIG)"
config ZEPHYR_ZCBOR_MODULE
	bool
	default y
endmenu
menu "module (/home/runner/work/ILI9341-nrf52840/ILI9341-nrf52840/zmk/app/module)"
osource "/home/runner/work/ILI9341-nrf52840/ILI9341-nrf52840/zmk/app/module/Kconfig"
config ZEPHYR_MODULE_MODULE
	bool
	default y
endmenu
config ZEPHYR_KEYMAP_MODULE_MODULE
	bool
	default y
config ZEPHYR_NRF_HW_MODELS_MODULE
	bool
	default y
```

## build/Kconfig/arch/Kconfig
```kconfig
# Load Zephyr Arch Kconfig descriptions.
osource "/home/runner/work/ILI9341-nrf52840/ILI9341-nrf52840/zephyr/arch/x86/Kconfig"
osource "/home/runner/work/ILI9341-nrf52840/ILI9341-nrf52840/zephyr/arch/xtensa/Kconfig"
osource "/home/runner/work/ILI9341-nrf52840/ILI9341-nrf52840/zephyr/arch/sparc/Kconfig"
osource "/home/runner/work/ILI9341-nrf52840/ILI9341-nrf52840/zephyr/arch/riscv/Kconfig"
osource "/home/runner/work/ILI9341-nrf52840/ILI9341-nrf52840/zephyr/arch/posix/Kconfig"
osource "/home/runner/work/ILI9341-nrf52840/ILI9341-nrf52840/zephyr/arch/nios2/Kconfig"
osource "/home/runner/work/ILI9341-nrf52840/ILI9341-nrf52840/zephyr/arch/mips/Kconfig"
osource "/home/runner/work/ILI9341-nrf52840/ILI9341-nrf52840/zephyr/arch/arm64/Kconfig"
osource "/home/runner/work/ILI9341-nrf52840/ILI9341-nrf52840/zephyr/arch/arm/Kconfig"
osource "/home/runner/work/ILI9341-nrf52840/ILI9341-nrf52840/zephyr/arch/arc/Kconfig"
```

## build/Kconfig/boards/Kconfig
```kconfig
# Load Zephyr board Kconfig descriptions.
osource "/home/runner/work/ILI9341-nrf52840/ILI9341-nrf52840/zmk/app/module/boards/nicekeyboards/nice_nano/Kconfig"
osource "/home/runner/work/ILI9341-nrf52840/ILI9341-nrf52840/zmk/app/boards/nicekeyboards/nice_nano/Kconfig"
```

## build/Kconfig/boards/Kconfig.defconfig
```kconfig
# Load Zephyr board defconfig descriptions.
osource "/home/runner/work/ILI9341-nrf52840/ILI9341-nrf52840/zmk/app/module/boards/nicekeyboards/nice_nano/Kconfig.defconfig"
osource "/home/runner/work/ILI9341-nrf52840/ILI9341-nrf52840/zmk/app/boards/nicekeyboards/nice_nano/Kconfig.defconfig"
```

## config/boards/shields/ili9341_test/Kconfig.defconfig
```kconfig
if SHIELD_ILI9341_TEST

config ZMK_KEYBOARD_NAME
	default "ILI9341 Test"

config ZMK_DISPLAY
	default y

endif # SHIELD_ILI9341_TEST
```
