#include <behaviors.dtsi>
#include <dt-bindings/zmk/keys.h>
#include <dt-bindings/zmk/bt.h>

/*
 * Minimal test keymap – one physical key (D5 / P0.24).
 *
 * Layer 0 (DEFAULT): press the button → sends Space.
 *
 * Extend this keymap once you have a real keyboard matrix.
 */

/ {
    keymap {
        compatible = "zmk,keymap";

        default_layer {
            label = "DEFAULT";
            bindings = <
                &kp SPACE
            >;
        };
    };
};
